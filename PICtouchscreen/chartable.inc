char_table
	db .1,LOW(char_data_0),HIGH(char_data_0),UPPER(char_data_0)
	db .2,LOW(char_data_1),HIGH(char_data_1),UPPER(char_data_1)
	db .3,LOW(char_data_2),HIGH(char_data_2),UPPER(char_data_2)
	db .5,LOW(char_data_3),HIGH(char_data_3),UPPER(char_data_3)
	db .5,LOW(char_data_4),HIGH(char_data_4),UPPER(char_data_4)
	db .3,LOW(char_data_5),HIGH(char_data_5),UPPER(char_data_5)
	db .4,LOW(char_data_6),HIGH(char_data_6),UPPER(char_data_6)
	db .1,LOW(char_data_7),HIGH(char_data_7),UPPER(char_data_7)
	db .3,LOW(char_data_8),HIGH(char_data_8),UPPER(char_data_8)
	db .3,LOW(char_data_9),HIGH(char_data_9),UPPER(char_data_9)
	db .5,LOW(char_data_10),HIGH(char_data_10),UPPER(char_data_10)
	db .3,LOW(char_data_11),HIGH(char_data_11),UPPER(char_data_11)
	db .2,LOW(char_data_12),HIGH(char_data_12),UPPER(char_data_12)
	db .3,LOW(char_data_13),HIGH(char_data_13),UPPER(char_data_13)
	db .1,LOW(char_data_14),HIGH(char_data_14),UPPER(char_data_14)
	db .3,LOW(char_data_15),HIGH(char_data_15),UPPER(char_data_15)
	db .4,LOW(char_data_16),HIGH(char_data_16),UPPER(char_data_16)
	db .3,LOW(char_data_17),HIGH(char_data_17),UPPER(char_data_17)
	db .4,LOW(char_data_18),HIGH(char_data_18),UPPER(char_data_18)
	db .4,LOW(char_data_19),HIGH(char_data_19),UPPER(char_data_19)
	db .4,LOW(char_data_20),HIGH(char_data_20),UPPER(char_data_20)
	db .4,LOW(char_data_21),HIGH(char_data_21),UPPER(char_data_21)
	db .4,LOW(char_data_22),HIGH(char_data_22),UPPER(char_data_22)
	db .4,LOW(char_data_23),HIGH(char_data_23),UPPER(char_data_23)
	db .4,LOW(char_data_24),HIGH(char_data_24),UPPER(char_data_24)
	db .4,LOW(char_data_25),HIGH(char_data_25),UPPER(char_data_25)
	db .1,LOW(char_data_26),HIGH(char_data_26),UPPER(char_data_26)
	db .2,LOW(char_data_27),HIGH(char_data_27),UPPER(char_data_27)
	db .3,LOW(char_data_28),HIGH(char_data_28),UPPER(char_data_28)
	db .3,LOW(char_data_29),HIGH(char_data_29),UPPER(char_data_29)
	db .3,LOW(char_data_30),HIGH(char_data_30),UPPER(char_data_30)
	db .3,LOW(char_data_31),HIGH(char_data_31),UPPER(char_data_31)
	db .5,LOW(char_data_32),HIGH(char_data_32),UPPER(char_data_32)
	db .3,LOW(char_data_33),HIGH(char_data_33),UPPER(char_data_33)
	db .3,LOW(char_data_34),HIGH(char_data_34),UPPER(char_data_34)
	db .3,LOW(char_data_35),HIGH(char_data_35),UPPER(char_data_35)
	db .3,LOW(char_data_36),HIGH(char_data_36),UPPER(char_data_36)
	db .3,LOW(char_data_37),HIGH(char_data_37),UPPER(char_data_37)
	db .3,LOW(char_data_38),HIGH(char_data_38),UPPER(char_data_38)
	db .4,LOW(char_data_39),HIGH(char_data_39),UPPER(char_data_39)
	db .3,LOW(char_data_40),HIGH(char_data_40),UPPER(char_data_40)
	db .3,LOW(char_data_41),HIGH(char_data_41),UPPER(char_data_41)
	db .4,LOW(char_data_42),HIGH(char_data_42),UPPER(char_data_42)
	db .3,LOW(char_data_43),HIGH(char_data_43),UPPER(char_data_43)
	db .3,LOW(char_data_44),HIGH(char_data_44),UPPER(char_data_44)
	db .5,LOW(char_data_45),HIGH(char_data_45),UPPER(char_data_45)
	db .4,LOW(char_data_46),HIGH(char_data_46),UPPER(char_data_46)
	db .3,LOW(char_data_47),HIGH(char_data_47),UPPER(char_data_47)
	db .3,LOW(char_data_48),HIGH(char_data_48),UPPER(char_data_48)
	db .4,LOW(char_data_49),HIGH(char_data_49),UPPER(char_data_49)
	db .3,LOW(char_data_50),HIGH(char_data_50),UPPER(char_data_50)
	db .3,LOW(char_data_51),HIGH(char_data_51),UPPER(char_data_51)
	db .3,LOW(char_data_52),HIGH(char_data_52),UPPER(char_data_52)
	db .3,LOW(char_data_53),HIGH(char_data_53),UPPER(char_data_53)
	db .3,LOW(char_data_54),HIGH(char_data_54),UPPER(char_data_54)
	db .5,LOW(char_data_55),HIGH(char_data_55),UPPER(char_data_55)
	db .3,LOW(char_data_56),HIGH(char_data_56),UPPER(char_data_56)
	db .3,LOW(char_data_57),HIGH(char_data_57),UPPER(char_data_57)
	db .3,LOW(char_data_58),HIGH(char_data_58),UPPER(char_data_58)
	db .2,LOW(char_data_59),HIGH(char_data_59),UPPER(char_data_59)
	db .3,LOW(char_data_60),HIGH(char_data_60),UPPER(char_data_60)
	db .2,LOW(char_data_61),HIGH(char_data_61),UPPER(char_data_61)
	db .3,LOW(char_data_62),HIGH(char_data_62),UPPER(char_data_62)
	db .3,LOW(char_data_63),HIGH(char_data_63),UPPER(char_data_63)
	db .2,LOW(char_data_64),HIGH(char_data_64),UPPER(char_data_64)
	db .4,LOW(char_data_65),HIGH(char_data_65),UPPER(char_data_65)
	db .3,LOW(char_data_66),HIGH(char_data_66),UPPER(char_data_66)
	db .2,LOW(char_data_67),HIGH(char_data_67),UPPER(char_data_67)
	db .3,LOW(char_data_68),HIGH(char_data_68),UPPER(char_data_68)
	db .3,LOW(char_data_69),HIGH(char_data_69),UPPER(char_data_69)
	db .3,LOW(char_data_70),HIGH(char_data_70),UPPER(char_data_70)
	db .3,LOW(char_data_71),HIGH(char_data_71),UPPER(char_data_71)
	db .3,LOW(char_data_72),HIGH(char_data_72),UPPER(char_data_72)
	db .1,LOW(char_data_73),HIGH(char_data_73),UPPER(char_data_73)
	db .2,LOW(char_data_74),HIGH(char_data_74),UPPER(char_data_74)
	db .3,LOW(char_data_75),HIGH(char_data_75),UPPER(char_data_75)
	db .1,LOW(char_data_76),HIGH(char_data_76),UPPER(char_data_76)
	db .5,LOW(char_data_77),HIGH(char_data_77),UPPER(char_data_77)
	db .3,LOW(char_data_78),HIGH(char_data_78),UPPER(char_data_78)
	db .3,LOW(char_data_79),HIGH(char_data_79),UPPER(char_data_79)
	db .3,LOW(char_data_80),HIGH(char_data_80),UPPER(char_data_80)
	db .3,LOW(char_data_81),HIGH(char_data_81),UPPER(char_data_81)
	db .3,LOW(char_data_82),HIGH(char_data_82),UPPER(char_data_82)
	db .3,LOW(char_data_83),HIGH(char_data_83),UPPER(char_data_83)
	db .3,LOW(char_data_84),HIGH(char_data_84),UPPER(char_data_84)
	db .3,LOW(char_data_85),HIGH(char_data_85),UPPER(char_data_85)
	db .3,LOW(char_data_86),HIGH(char_data_86),UPPER(char_data_86)
	db .5,LOW(char_data_87),HIGH(char_data_87),UPPER(char_data_87)
	db .3,LOW(char_data_88),HIGH(char_data_88),UPPER(char_data_88)
	db .3,LOW(char_data_89),HIGH(char_data_89),UPPER(char_data_89)
	db .3,LOW(char_data_90),HIGH(char_data_90),UPPER(char_data_90)
	db .3,LOW(char_data_91),HIGH(char_data_91),UPPER(char_data_91)
	db .1,LOW(char_data_92),HIGH(char_data_92),UPPER(char_data_92)
	db .3,LOW(char_data_93),HIGH(char_data_93),UPPER(char_data_93)
	db .5,LOW(char_data_94),HIGH(char_data_94),UPPER(char_data_94)
	db .7,LOW(char_data_95),HIGH(char_data_95),UPPER(char_data_95)
	db .4,LOW(char_data_96),HIGH(char_data_96),UPPER(char_data_96)
	db .4,LOW(char_data_97),HIGH(char_data_97),UPPER(char_data_97)
	db .4,LOW(char_data_98),HIGH(char_data_98),UPPER(char_data_98)
	db .4,LOW(char_data_99),HIGH(char_data_99),UPPER(char_data_99)
	db .4,LOW(char_data_100),HIGH(char_data_100),UPPER(char_data_100)
	db .5,LOW(char_data_101),HIGH(char_data_101),UPPER(char_data_101)
	db .4,LOW(char_data_102),HIGH(char_data_102),UPPER(char_data_102)
	db .5,LOW(char_data_103),HIGH(char_data_103),UPPER(char_data_103)
	db .7,LOW(char_data_104),HIGH(char_data_104),UPPER(char_data_104)
	db .5,LOW(char_data_105),HIGH(char_data_105),UPPER(char_data_105)
	db .5,LOW(char_data_106),HIGH(char_data_106),UPPER(char_data_106)
	db .9,LOW(char_data_107),HIGH(char_data_107),UPPER(char_data_107)
	db .8,LOW(char_data_108),HIGH(char_data_108),UPPER(char_data_108)
	db .9,LOW(char_data_109),HIGH(char_data_109),UPPER(char_data_109)

char_data_0
	db b'00000000'
char_data_1
	db b'00000000',b'01111010'
char_data_2
	db b'01100000',b'00000000',b'01100000'
char_data_3
	db b'00101000',b'01111100',b'00101000',b'01111100',b'00101000'
char_data_4
	db b'00010010',b'00101010',b'01111111',b'00101010',b'00100100'
char_data_5
	db b'01001100',b'00010000',b'01100100'
char_data_6
	db b'00101100',b'01010010',b'00101100',b'00001010'
char_data_7
	db b'01100000'
char_data_8
	db b'00011000',b'00100100',b'01000010'
char_data_9
	db b'01000010',b'00100100',b'00011000'
char_data_10
	db b'00101000',b'00010000',b'01111100',b'00010000',b'00101000'
char_data_11
	db b'00010000',b'00111000',b'00010000'
char_data_12
	db b'00000100',b'00001000'
char_data_13
	db b'00010000',b'00010000',b'00010000'
char_data_14
	db b'00000100'
char_data_15
	db b'00000110',b'00011000',b'01100000'
char_data_16
	db b'00111000',b'01100100',b'01001100',b'00111000'
char_data_17
	db b'00100100',b'01111100',b'00000100'
char_data_18
	db b'00100100',b'01001100',b'01010100',b'00100100'
char_data_19
	db b'00101000',b'01000100',b'01010100',b'00101000'
char_data_20
	db b'00011000',b'00101000',b'01111100',b'00001000'
char_data_21
	db b'01101000',b'01010100',b'01010100',b'01001000'
char_data_22
	db b'00111000',b'01010100',b'01010100',b'00001000'
char_data_23
	db b'01000000',b'01001100',b'01010000',b'01100000'
char_data_24
	db b'00101000',b'01010100',b'01010100',b'00101000'
char_data_25
	db b'00100000',b'01010100',b'01010100',b'00111000'
char_data_26
	db b'00101000'
char_data_27
	db b'00000100',b'00101000'
char_data_28
	db b'00010000',b'00101000',b'01000100'
char_data_29
	db b'00101000',b'00101000',b'00101000'
char_data_30
	db b'01000100',b'00101000',b'00010000'
char_data_31
	db b'00100000',b'01001010',b'00110000'
char_data_32
	db b'00111100',b'01000010',b'01011010',b'01001010',b'00111000'
char_data_33
	db b'00111100',b'01001000',b'00111100'
char_data_34
	db b'01111100',b'01010100',b'00101000'
char_data_35
	db b'00111000',b'01000100',b'00101000'
char_data_36
	db b'01111100',b'01000100',b'00111000'
char_data_37
	db b'01111100',b'01010100',b'01000100'
char_data_38
	db b'01111100',b'01010000',b'01000000'
char_data_39
	db b'00111000',b'01000100',b'01010100',b'00011000'
char_data_40
	db b'01111100',b'00010000',b'01111100'
char_data_41
	db b'01000100',b'01111100',b'01000100'
char_data_42
	db b'00001000',b'01000100',b'01111000',b'01000000'
char_data_43
	db b'01111100',b'00010000',b'01101100'
char_data_44
	db b'01111100',b'00000100',b'00000100'
char_data_45
	db b'01111100',b'00100000',b'00010000',b'00100000',b'01111100'
char_data_46
	db b'01111100',b'00100000',b'00010000',b'01111100'
char_data_47
	db b'00111000',b'01000100',b'00111000'
char_data_48
	db b'01111100',b'01010000',b'01110000'
char_data_49
	db b'00111000',b'01000100',b'01001000',b'00110100'
char_data_50
	db b'01111100',b'01010000',b'00101100'
char_data_51
	db b'00100100',b'01010100',b'01001000'
char_data_52
	db b'01000000',b'01111100',b'01000000'
char_data_53
	db b'01111000',b'00000100',b'01111100'
char_data_54
	db b'01111000',b'00000100',b'01111000'
char_data_55
	db b'01111000',b'00000100',b'00011000',b'00000100',b'01111000'
char_data_56
	db b'01101100',b'00010000',b'01101100'
char_data_57
	db b'01100000',b'00011100',b'01100000'
char_data_58
	db b'01001100',b'01010100',b'01100100'
char_data_59
	db b'01111110',b'01000010'
char_data_60
	db b'01100000',b'00011000',b'00000110'
char_data_61
	db b'01000010',b'01111110'
char_data_62
	db b'00100000',b'01000000',b'00100000'
char_data_63
	db b'00000010',b'00000010',b'00000010'
char_data_64
	db b'01000000',b'00100000'
char_data_65
	db b'00011000',b'00100100',b'00111000',b'00000100'
char_data_66
	db b'00111100',b'00010100',b'00001000'
char_data_67
	db b'00011000',b'00100100'
char_data_68
	db b'00001000',b'00010100',b'00111100'
char_data_69
	db b'00011000',b'00101100',b'00010100'
char_data_70
	db b'00010010',b'00111100',b'01010000'
char_data_71
	db b'00010000',b'00101010',b'00010100'
char_data_72
	db b'00111100',b'00010000',b'00001100'
char_data_73
	db b'00101100'
char_data_74
	db b'00001010',b'00101100'
char_data_75
	db b'00111100',b'00001000',b'00010100'
char_data_76
	db b'00111100'
char_data_77
	db b'00011100',b'00100000',b'00011100',b'00100000',b'00011100'
char_data_78
	db b'00011100',b'00100000',b'00011100'
char_data_79
	db b'00011000',b'00100100',b'00011000'
char_data_80
	db b'00111100',b'00101000',b'00010000'
char_data_81
	db b'00010000',b'00101000',b'00111100'
char_data_82
	db b'00011100',b'00100000',b'00010000'
char_data_83
	db b'00010100',b'00110100',b'00101000'
char_data_84
	db b'00010000',b'00111100',b'00010000'
char_data_85
	db b'00111000',b'00000100',b'00111100'
char_data_86
	db b'00111000',b'00000100',b'00111000'
char_data_87
	db b'00111000',b'00000100',b'00001000',b'00000100',b'00111000'
char_data_88
	db b'00101100',b'00010000',b'00101100'
char_data_89
	db b'00110000',b'00001010',b'00111100'
char_data_90
	db b'00101100',b'00110100',b'00100100'
char_data_91
	db b'00010000',b'01101100',b'10000010'
char_data_92
	db b'01111110'
char_data_93
	db b'10000010',b'01101100',b'00010000'
char_data_94
	db b'00000000',b'00100000',b'01000000',b'00100000',b'01000000'
char_data_95
	db b'01111100',b'00000000',b'01000100',b'01010100',b'01010100',b'01101100',b'01000100'
char_data_96
	db b'00001001',b'00000101',b'00000011',b'00001111'
char_data_97
	db b'11110000',b'11000000',b'10100000',b'10010000'
char_data_98
	db b'10010000',b'10100000',b'11000000',b'11110000'
char_data_99
	db b'00001111',b'00000011',b'00000101',b'00001001'
char_data_100
	db b'00010000',b'00111000',b'01010100',b'00010000'
char_data_101
	db b'00100000',b'01000000',b'11110000',b'01000000',b'00100000'
char_data_102
	db b'00010000',b'01010100',b'00111000',b'00010000'
char_data_103
	db b'00010000',b'00001000',b'00111100',b'00001000',b'00010000'
char_data_104
	db b'00000100',b'00111100',b'00100000',b'00111100',b'00000100',b'00111100',b'00100000'
char_data_105
	db b'00001000',b'00100100',b'00000100',b'00100100',b'00001000'
char_data_106
	db b'00010000',b'00010000',b'01101100',b'00010000',b'00010000'
char_data_107
	db b'00000010',b'00000100',b'00001000',b'00010000',b'00111110',b'00000100',b'00001000',b'00010000',b'00111110'
char_data_108
	db b'00110000',b'01000000',b'01000000',b'00110000',b'00001100',b'00000010',b'00000010',b'00001100'
char_data_109
	db b'00010000',b'00100000',b'01000000',b'00100000',b'00010000',b'00001000',b'00000100',b'00001000',b'00010000'
